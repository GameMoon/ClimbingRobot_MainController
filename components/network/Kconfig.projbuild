## components/network/Kconfig.projbuild
```kconfig
menu "ClimbingRobot Network Configuration"
    
    config ESP_WIFI_MODE
        bool "Is SoftAP mode"
        default n
        help
            If true, then it creates an AP otherwise it's a normal client

    config ESP_WIFI_SSID
        string "WiFi SSID"
        default "myssid"
        help
            SSID (network name) for the example to connect to.

    config ESP_WIFI_PASSWORD
        string "WiFi Password"
        default "mypassword"
        help
            WiFi password (WPA or WPA2) for the example to use.

    config ESP_MAXIMUM_RETRY
        int "Maximum retry"
        default 5
        help
            Set the Maximum retry to avoid station reconnecting to the AP unlimited when the AP is really inexistent.
endmenu
```
